## config/boards/shields/dactyl_manuform_4x6/Kconfig.defconfig
```kconfig
if SHIELD_DACTYL_MANUFORM_4x6_LEFT

    config ZMK_KEYBOARD_NAME
        default "Aarons Dactyl L"

    config ZMK_SPLIT_BLE_ROLE_CENTRAL
        default y

endif

if SHIELD_DACTYL_MANUFORM_4x6_RIGHT

    config ZMK_KEYBOARD_NAME
        default "Aarons Dactyl RBKT"

endif

if SHIELD_DACTYL_MANUFORM_4x6_LEFT || SHIELD_DACTYL_MANUFORM_4x6_RIGHT

    config ZMK_SPLIT
        default y

endif
```
